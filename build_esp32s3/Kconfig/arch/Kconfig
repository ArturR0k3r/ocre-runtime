## build_esp32s3/Kconfig/arch/Kconfig
```kconfig
# Load Zephyr Arch Kconfig descriptions.
osource "/home/artur_ubuntu/Akira/zephyr/arch/rx/Kconfig"
osource "/home/artur_ubuntu/Akira/zephyr/arch/x86/Kconfig"
osource "/home/artur_ubuntu/Akira/zephyr/arch/xtensa/Kconfig"
osource "/home/artur_ubuntu/Akira/zephyr/arch/sparc/Kconfig"
osource "/home/artur_ubuntu/Akira/zephyr/arch/riscv/Kconfig"
osource "/home/artur_ubuntu/Akira/zephyr/arch/posix/Kconfig"
osource "/home/artur_ubuntu/Akira/zephyr/arch/mips/Kconfig"
osource "/home/artur_ubuntu/Akira/zephyr/arch/arm64/Kconfig"
osource "/home/artur_ubuntu/Akira/zephyr/arch/arm/Kconfig"
osource "/home/artur_ubuntu/Akira/zephyr/arch/arc/Kconfig"
```

## build_esp32s3/Kconfig/boards/Kconfig.defconfig
```kconfig
# Load Zephyr board defconfig descriptions.
osource "/home/artur_ubuntu/Akira/zephyr/boards/espressif/esp32s3_devkitm/Kconfig.defconfig"
```

## build_esp32s3/Kconfig/boards/Kconfig.esp32s3_devkitm
```kconfig
# Load board Kconfig descriptions.
osource "/home/artur_ubuntu/Akira/zephyr/boards/espressif/esp32s3_devkitm/Kconfig.esp32s3_devkitm"
```

## build_esp32s3/Kconfig/boards/Kconfig.sysbuild
```kconfig
# Load Sysbuild board Kconfig descriptions.
osource "/home/artur_ubuntu/Akira/zephyr/boards/espressif/esp32s3_devkitm/Kconfig.sysbuild"
```

## build_esp32s3/Kconfig/soc/Kconfig
```kconfig
# Load Zephyr SoC Kconfig descriptions.
osource "/home/artur_ubuntu/Akira/zephyr/soc/xlnx/zynqmp/Kconfig"
osource "/home/artur_ubuntu/Akira/zephyr/soc/xlnx/zynq7000/Kconfig"
osource "/home/artur_ubuntu/Akira/zephyr/soc/xlnx/versalnet/Kconfig"
osource "/home/artur_ubuntu/Akira/zephyr/soc/xlnx/versal2/Kconfig"
osource "/home/artur_ubuntu/Akira/zephyr/soc/xen/Kconfig"
osource "/home/artur_ubuntu/Akira/zephyr/soc/wch/ch32v/Kconfig"
osource "/home/artur_ubuntu/Akira/zephyr/soc/ti/simplelink/Kconfig"
osource "/home/artur_ubuntu/Akira/zephyr/soc/ti/mspm0/Kconfig"
osource "/home/artur_ubuntu/Akira/zephyr/soc/ti/lm3s6965/Kconfig"
osource "/home/artur_ubuntu/Akira/zephyr/soc/ti/k3/Kconfig"
osource "/home/artur_ubuntu/Akira/zephyr/soc/telink/tlsr/Kconfig"
osource "/home/artur_ubuntu/Akira/zephyr/soc/starfive/jh71xx/Kconfig"
osource "/home/artur_ubuntu/Akira/zephyr/soc/st/stm32/Kconfig"
osource "/home/artur_ubuntu/Akira/zephyr/soc/snps/qemu_arc/Kconfig"
osource "/home/artur_ubuntu/Akira/zephyr/soc/snps/nsim/arc_v/Kconfig"
osource "/home/artur_ubuntu/Akira/zephyr/soc/snps/nsim/arc_classic/Kconfig"
osource "/home/artur_ubuntu/Akira/zephyr/soc/snps/hsdk4xd/Kconfig"
osource "/home/artur_ubuntu/Akira/zephyr/soc/snps/hsdk/Kconfig"
osource "/home/artur_ubuntu/Akira/zephyr/soc/snps/emsk/Kconfig"
osource "/home/artur_ubuntu/Akira/zephyr/soc/snps/emsdp/Kconfig"
osource "/home/artur_ubuntu/Akira/zephyr/soc/snps/arc_iot/Kconfig"
osource "/home/artur_ubuntu/Akira/zephyr/soc/silabs/Kconfig"
osource "/home/artur_ubuntu/Akira/zephyr/soc/sifive/sifive_freedom/Kconfig"
osource "/home/artur_ubuntu/Akira/zephyr/soc/sensry/Kconfig"
osource "/home/artur_ubuntu/Akira/zephyr/soc/rockchip/Kconfig"
osource "/home/artur_ubuntu/Akira/zephyr/soc/renode/riscv_virtual/Kconfig"
osource "/home/artur_ubuntu/Akira/zephyr/soc/renode/cortex_r8_virtual/Kconfig"
osource "/home/artur_ubuntu/Akira/zephyr/soc/renesas/smartbond/Kconfig"
osource "/home/artur_ubuntu/Akira/zephyr/soc/renesas/rz/Kconfig"
osource "/home/artur_ubuntu/Akira/zephyr/soc/renesas/rx/Kconfig"
osource "/home/artur_ubuntu/Akira/zephyr/soc/renesas/rcar/Kconfig"
osource "/home/artur_ubuntu/Akira/zephyr/soc/renesas/ra/Kconfig"
osource "/home/artur_ubuntu/Akira/zephyr/soc/realtek/ec/Kconfig"
osource "/home/artur_ubuntu/Akira/zephyr/soc/raspberrypi/rpi_pico/Kconfig"
osource "/home/artur_ubuntu/Akira/zephyr/soc/quicklogic/eos_s3/Kconfig"
osource "/home/artur_ubuntu/Akira/zephyr/soc/qemu/virt_riscv/Kconfig"
osource "/home/artur_ubuntu/Akira/zephyr/soc/qemu/malta/Kconfig"
osource "/home/artur_ubuntu/Akira/zephyr/soc/openisa/rv32m1/Kconfig"
osource "/home/artur_ubuntu/Akira/zephyr/soc/openhwgroup/cva6/Kconfig"
osource "/home/artur_ubuntu/Akira/zephyr/soc/oct/osd32mp15x/Kconfig"
osource "/home/artur_ubuntu/Akira/zephyr/soc/nxp/s32/Kconfig"
osource "/home/artur_ubuntu/Akira/zephyr/soc/nxp/rw/Kconfig"
osource "/home/artur_ubuntu/Akira/zephyr/soc/nxp/mcx/Kconfig"
osource "/home/artur_ubuntu/Akira/zephyr/soc/nxp/lpc/Kconfig"
osource "/home/artur_ubuntu/Akira/zephyr/soc/nxp/layerscape/Kconfig"
osource "/home/artur_ubuntu/Akira/zephyr/soc/nxp/kinetis/Kconfig"
osource "/home/artur_ubuntu/Akira/zephyr/soc/nxp/imxrt/Kconfig"
osource "/home/artur_ubuntu/Akira/zephyr/soc/nxp/imx/Kconfig"
osource "/home/artur_ubuntu/Akira/zephyr/soc/nuvoton/numicro/Kconfig"
osource "/home/artur_ubuntu/Akira/zephyr/soc/nuvoton/numaker/Kconfig"
osource "/home/artur_ubuntu/Akira/zephyr/soc/nuvoton/npcx/Kconfig"
osource "/home/artur_ubuntu/Akira/zephyr/soc/nuvoton/npcm/Kconfig"
osource "/home/artur_ubuntu/Akira/zephyr/soc/nordic/Kconfig"
osource "/home/artur_ubuntu/Akira/zephyr/soc/neorv32/Kconfig"
osource "/home/artur_ubuntu/Akira/zephyr/soc/native/inf_clock/Kconfig"
osource "/home/artur_ubuntu/Akira/zephyr/soc/microchip/sam/Kconfig"
osource "/home/artur_ubuntu/Akira/zephyr/soc/microchip/miv/Kconfig"
osource "/home/artur_ubuntu/Akira/zephyr/soc/microchip/mec/Kconfig"
osource "/home/artur_ubuntu/Akira/zephyr/soc/mediatek/mt8xxx/Kconfig"
osource "/home/artur_ubuntu/Akira/zephyr/soc/lowrisc/opentitan/Kconfig"
osource "/home/artur_ubuntu/Akira/zephyr/soc/litex/litex_vexriscv/Kconfig"
osource "/home/artur_ubuntu/Akira/zephyr/soc/ite/ec/Kconfig"
osource "/home/artur_ubuntu/Akira/zephyr/soc/intel/raptor_lake/Kconfig"
osource "/home/artur_ubuntu/Akira/zephyr/soc/intel/lakemont/Kconfig"
osource "/home/artur_ubuntu/Akira/zephyr/soc/intel/intel_socfpga_std/Kconfig"
osource "/home/artur_ubuntu/Akira/zephyr/soc/intel/intel_socfpga/Kconfig"
osource "/home/artur_ubuntu/Akira/zephyr/soc/intel/intel_niosv/Kconfig"
osource "/home/artur_ubuntu/Akira/zephyr/soc/intel/intel_ish/Kconfig"
osource "/home/artur_ubuntu/Akira/zephyr/soc/intel/intel_adsp/Kconfig"
osource "/home/artur_ubuntu/Akira/zephyr/soc/intel/elkhart_lake/Kconfig"
osource "/home/artur_ubuntu/Akira/zephyr/soc/intel/atom/Kconfig"
osource "/home/artur_ubuntu/Akira/zephyr/soc/intel/apollo_lake/Kconfig"
osource "/home/artur_ubuntu/Akira/zephyr/soc/intel/alder_lake/Kconfig"
osource "/home/artur_ubuntu/Akira/zephyr/soc/infineon/cat3/Kconfig"
osource "/home/artur_ubuntu/Akira/zephyr/soc/infineon/cat1c/Kconfig"
osource "/home/artur_ubuntu/Akira/zephyr/soc/infineon/cat1b/Kconfig"
osource "/home/artur_ubuntu/Akira/zephyr/soc/infineon/cat1a/Kconfig"
osource "/home/artur_ubuntu/Akira/zephyr/soc/gd/gd32/Kconfig"
osource "/home/artur_ubuntu/Akira/zephyr/soc/gaisler/leon3/Kconfig"
osource "/home/artur_ubuntu/Akira/zephyr/soc/gaisler/gr716a/Kconfig"
osource "/home/artur_ubuntu/Akira/zephyr/soc/espressif/Kconfig"
osource "/home/artur_ubuntu/Akira/zephyr/soc/ene/kb1200/Kconfig"
osource "/home/artur_ubuntu/Akira/zephyr/soc/ene/kb106x/Kconfig"
osource "/home/artur_ubuntu/Akira/zephyr/soc/efinix/sapphire/Kconfig"
osource "/home/artur_ubuntu/Akira/zephyr/soc/cdns/xtensa_sample_controller/Kconfig"
osource "/home/artur_ubuntu/Akira/zephyr/soc/cdns/sample_controller32/Kconfig"
osource "/home/artur_ubuntu/Akira/zephyr/soc/cdns/dc233c/Kconfig"
osource "/home/artur_ubuntu/Akira/zephyr/soc/brcm/bcmvk/Kconfig"
osource "/home/artur_ubuntu/Akira/zephyr/soc/brcm/bcm2712/Kconfig"
osource "/home/artur_ubuntu/Akira/zephyr/soc/brcm/bcm2711/Kconfig"
osource "/home/artur_ubuntu/Akira/zephyr/soc/bflb/Kconfig"
osource "/home/artur_ubuntu/Akira/zephyr/soc/atmel/sam0/Kconfig"
osource "/home/artur_ubuntu/Akira/zephyr/soc/atmel/sam/Kconfig"
osource "/home/artur_ubuntu/Akira/zephyr/soc/aspeed/Kconfig"
osource "/home/artur_ubuntu/Akira/zephyr/soc/arm/Kconfig"
osource "/home/artur_ubuntu/Akira/zephyr/soc/arm/beetle/Kconfig"
osource "/home/artur_ubuntu/Akira/zephyr/soc/antmicro/myra/Kconfig"
osource "/home/artur_ubuntu/Akira/zephyr/soc/andestech/Kconfig"
osource "/home/artur_ubuntu/Akira/zephyr/soc/amd/acp_6_0/Kconfig"
osource "/home/artur_ubuntu/Akira/zephyr/soc/ambiq/Kconfig"
osource "/home/artur_ubuntu/Akira/zephyr/soc/aesc/Kconfig"
osource "/home/artur_ubuntu/Akira/zephyr/soc/adi/max32/Kconfig"
```
